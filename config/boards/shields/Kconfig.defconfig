## config/boards/shields/Kconfig.defconfig
```kconfig
if SHIELD_HOURGLASS_LEFT

config ZMK_KEYBOARD_NAME
    default "Hourglass Twins"

config ZMK_SPLIT_ROLE_CENTRAL
    default y

endif

if SHIELD_HOURGLASS_LEFT || SHIELD_HOURGLASS_RIGHT

config ZMK_SPLIT
    default y

endif
```

## config/boards/shields/Kconfig.shield
```kconfig
config SHIELD_HOURGLASS_LEFT
    def_bool $(shields_list_contains,hourglass_left)

config SHIELD_HOURGLASS_RIGHT
    def_bool $(shields_list_contains,hourglass_right)
```
